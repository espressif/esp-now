## examples/solution/main/Kconfig.projbuild
```kconfig
menu "Example Configuration"
    choice APP_ESPNOW_SOLUTION_MODE
        bool "ESP-NOW Mode"
        default APP_ESPNOW_INITIATOR
        help
            Select the ESP-NOW Mode.

        config APP_ESPNOW_INITIATOR
            bool "Initiator Mode"
            select APP_WIFI_PROVISION
            help
                Select the ESP-NOW initiator Mode.

        config APP_ESPNOW_RESPONDER
            bool "Responder Mode"
            help
                Select the ESP-NOW responder Mode.

    endchoice

    config APP_ESPNOW_QUEUE_SIZE
        int "Size of packet buffer queue"
        default 32
        help
            Default is 32. If devices of initiator and responders is more than 32, please increase 
            this number to decrease ESP-NOW send queue fail error. For example, set 100 when the
            number of responder devices is 100.

    config APP_ESPNOW_CONTROL
        bool "Enable ESP-NOW Control"
        default y
        help
            Enable ESP-NOW control.

     config APP_ESPNOW_DEBUG
        bool "Enable ESP-NOW Debug"
        default y
        help
            Enable ESP-NOW debug.

   config APP_ESPNOW_OTA
        bool "Enable ESP-NOW OTA"
        default y
        help
            Enable ESP-NOW OTA.

    config APP_ESPNOW_SECURITY
        bool "Enable ESP-NOW Security"
        default y
        help
            Enable ESP-NOW security.

    config APP_ESPNOW_SESSION_POP
        string "Proof of Possession"
        default "espnow_pop"
        depends on APP_ESPNOW_SECURITY
        help
            Proof of Possession (PoP) string used to authorize session and derive shared key.

    config APP_POST_LOG_TO_HTTP_SERVER
        bool "Post flash log to HTTP server"
        default n
        depends on APP_ESPNOW_DEBUG && APP_ESPNOW_RESPONDER
        help
            Post flash log to HTTP server.

    config APP_FLASH_LOG_POST_URL
        string "URL of HTTP server"
        default "http://192.168.0.3:8070/flash_log"
        depends on APP_POST_LOG_TO_HTTP_SERVER
        help
            Flash log URL of HTTP server.

    config APP_WIFI_PROVISION
        bool "Enable WiFi Provision"
        default y
        depends on APP_ESPNOW_INITIATOR
        help
            Enable WiFi provision.

    menu "WiFi Provision Configuration"

        choice APP_WIFI_PROVISION_TRANSPORT
            bool "Provisioning Transport"
            default APP_WIFI_PROVISION_TRANSPORT_SOFTAP if IDF_TARGET_ESP32S2
            default APP_WIFI_PROVISION_TRANSPORT_BLE
            depends on APP_WIFI_PROVISION
            help
                WiFi provisioning component offers both, SoftAP and BLE transports. Choose any one.

            config APP_WIFI_PROVISION_TRANSPORT_BLE
                bool "BLE"
                select BT_ENABLED
                depends on !IDF_TARGET_ESP32S2
            config APP_WIFI_PROVISION_TRANSPORT_SOFTAP
                bool "SoftAP"
        endchoice

        config APP_WIFI_PROVISION_TRANSPORT
            int
            default 1 if APP_WIFI_PROVISION_TRANSPORT_BLE
            default 2 if APP_WIFI_PROVISION_TRANSPORT_SOFTAP

        config APP_WIFI_PROVISION_STATUS_RESET
            bool
            default n
            depends on APP_WIFI_PROVISION
            prompt "Reset provisioned status of the device"
            help
                This erases the NVS to reset provisioned status of the device on every reboot.
                Provisioned status is determined by the WiFi STA configuration, saved on the NVS.

        config APP_WIFI_PROVISION_RESET_PROV_MGR_ON_FAILURE
            bool
            default y
            depends on APP_WIFI_PROVISION
            prompt "Reset provisioned credentials and state machine after session failure"
            help
                Enable reseting provisioned credentials and state machine after session failure.
                This will restart the provisioning service after retries are exhausted.

        config APP_WIFI_PROVISION_PROV_MGR_MAX_RETRY_CNT
            int
            default 5
            prompt "Max retries before reseting provisioning state machine"
            depends on APP_WIFI_PROVISION_RESET_PROV_MGR_ON_FAILURE
            help
                Set the Maximum retry to avoid reconnecting to an inexistent AP or if credentials
                are misconfigured. Provisioned credentials are erased and internal state machine
                is reset after this threshold is reached.

        config APP_WIFI_PROVISION_SHOW_QR
            bool "Show provisioning QR code"
            default y
            depends on APP_WIFI_PROVISION
            help
                Show the QR code for provisioning.

        config APP_WIFI_PROVISION_USING_BLUEDROID
            bool
            depends on (BT_BLUEDROID_ENABLED && (IDF_TARGET_ESP32C2 || IDF_TARGET_ESP32C3 || IDF_TARGET_ESP32S3)) && APP_WIFI_PROVISION
            select BT_BLE_42_FEATURES_SUPPORTED
            default y
            help
                This enables BLE 4.2 features for Bluedroid.
    endmenu

    config APP_ESPNOW_PROVISION
        bool "Enable WiFi Provision over ESP-NOW"
        default y
        help
            Enable ESP-NOW provision.
endmenu
```

## examples/solution/sdkconfig.defaults
```kconfig
# Override some defaults in application project.

#
# Serial flasher config
#
CONFIG_ESPTOOLPY_FLASHSIZE_4MB=y
CONFIG_ESPTOOLPY_FLASHMODE_QIO=y
CONFIG_ESPTOOLPY_FLASHFREQ_80M=y
CONFIG_ESPTOOLPY_BAUD_921600B=y

#
# Partition Table
#
CONFIG_PARTITION_TABLE_CUSTOM=y
CONFIG_PARTITION_TABLE_CUSTOM_FILENAME="partitions_4MB.csv"

#
# ESP HTTPS OTA
#
CONFIG_OTA_ALLOW_HTTP=y

#
# FreeRTOS
#
CONFIG_FREERTOS_HZ=1000
CONFIG_FREERTOS_UNICORE=y
CONFIG_FREERTOS_USE_TRACE_FACILITY=y
CONFIG_FREERTOS_USE_STATS_FORMATTING_FUNCTIONS=y
CONFIG_FREERTOS_VTASKLIST_INCLUDE_COREID=y
CONFIG_FREERTOS_GENERATE_RUN_TIME_STATS=y
CONFIG_FREERTOS_TIMER_TASK_STACK_DEPTH=3072
CONFIG_FREERTOS_PLACE_FUNCTIONS_INTO_FLASH=y

CONFIG_ESP_TIMER_TASK_STACK_SIZE=4096
CONFIG_ESP_TASK_WDT_PANIC=y
CONFIG_ESP_TASK_WDT_TIMEOUT_S=10

#
# ESP32-specific
#
CONFIG_ESP32_ENABLE_COREDUMP=y
CONFIG_ESP32_ENABLE_COREDUMP_TO_FLASH=y

# Override some defaults so BT stack is enabled and
CONFIG_BT_ENABLED=y
CONFIG_BTDM_CTRL_MODE_BLE_ONLY=y
CONFIG_BTDM_CTRL_MODE_BR_EDR_ONLY=n
CONFIG_BTDM_CTRL_MODE_BTDM=n
CONFIG_BT_NIMBLE_ENABLED=y

#
# Compiler options
#
CONFIG_COMPILER_OPTIMIZATION_SIZE=y
```

## examples/wireless_debug/main/Kconfig.projbuild
```kconfig
menu "Example Configuration"

    choice APP_ESPNOW_DEBUG_MODE
        bool "ESP-NOW Debug Mode"
        default APP_ESPNOW_DEBUG_MONITORED
        help
            Select the ESP-NOW Debug Mode.

        config APP_ESPNOW_DEBUG_MONITOR
            bool "Monitor Mode"
            help
                Select the ESP-NOW debug as monitor Mode.

        config APP_ESPNOW_DEBUG_MONITORED
            bool "Monitored Mode"
            help
                Select the ESP-NOW debug as monitored Mode.

    endchoice

    config APP_WEB_SERVER
        bool "Enable WebServer for ESP-NOW debug"
        default n
        depends on APP_ESPNOW_DEBUG_MONITOR
        help
            Enable WebServer debugging

    config APP_MDNS_HOST_NAME
        string "mDNS Host Name"
        depends on APP_WEB_SERVER && APP_ESPNOW_DEBUG_MONITOR
        default "espnow-webserver"
        help
            Specify the domain name used in the mDNS service.
            Note that webpage also take it as a part of URL where it will send GET/POST requests to.


    config APP_WIFI_SOFTAP_SSID
        string "WiFi SoftAP SSID"
        depends on APP_WEB_SERVER && APP_ESPNOW_DEBUG_MONITOR
        default "espnow-webserver"
        help
            SoftAP SSID (network name) for the example to connect to.

    config APP_WEB_MOUNT_POINT
        string "Website mount point in VFS"
        depends on APP_WEB_SERVER && APP_ESPNOW_DEBUG_MONITOR
        default "/www"
        help
            Specify the mount point in VFS.

    config APP_POST_LOG_TO_HTTP_SERVER
        bool "Post flash log to HTTP server"
        default n
        depends on APP_ESPNOW_DEBUG_MONITORED
        help
            Post flash log to HTTP server.

    config APP_FLASH_LOG_POST_URL
        string "Flash log URL endpoint"
        default "http://192.168.0.3:8070/flash_log"
        depends on APP_POST_LOG_TO_HTTP_SERVER
        help
            Flash log URL endpoint.

endmenu
```

## examples/wireless_debug/sdkconfig.defaults
```kconfig
#
# Serial flasher config
#
CONFIG_ESPTOOLPY_FLASHSIZE_4MB=y
CONFIG_ESPTOOLPY_FLASHMODE_QIO=y
CONFIG_ESPTOOLPY_FLASHFREQ_80M=y
CONFIG_ESPTOOLPY_BAUD_921600B=y

#
# Partition Table
#
CONFIG_PARTITION_TABLE_CUSTOM=y


#
# Compiler options
#
CONFIG_COMPILER_OPTIMIZATION_PERF=y

#
# FreeRTOS
#
CONFIG_FREERTOS_HZ=1000
CONFIG_MAIN_TASK_STACK_SIZE=8192
CONFIG_TIMER_TASK_STACK_DEPTH=3072
CONFIG_FREERTOS_USE_TRACE_FACILITY=y
CONFIG_FREERTOS_USE_STATS_FORMATTING_FUNCTIONS=y
CONFIG_FREERTOS_VTASKLIST_INCLUDE_COREID=y
CONFIG_FREERTOS_GENERATE_RUN_TIME_STATS=y


# ESP32-specific
#
CONFIG_TASK_WDT_PANIC=y
CONFIG_TASK_WDT_TIMEOUT_S=30
CONFIG_TIMER_TASK_STACK_SIZE=4096

CONFIG_ESP32_DEFAULT_CPU_FREQ_240=y
CONFIG_ESP32_DEFAULT_CPU_FREQ_MHZ=240

CONFIG_ESP32S2_DEFAULT_CPU_FREQ_240=y
CONFIG_ESP32S2_DEFAULT_CPU_FREQ_MHZ=240

CONFIG_ESP32C3_DEFAULT_CPU_FREQ_160=y
CONFIG_ESP32C3_DEFAULT_CPU_FREQ_MHZ=160

#
# HTTP Server
#
CONFIG_HTTPD_MAX_URI_LEN=2048
CONFIG_HTTPD_MAX_REQ_HDR_LEN=4096
CONFIG_SPIFFS_OBJ_NAME_LEN=64
CONFIG_FATFS_LONG_FILENAME=y
CONFIG_FATFS_LFN_HEAP=y
CONFIG_HTTPD_WS_SUPPORT=y

#
# Wi-Fi optimized configuration
#
CONFIG_ESP32_WIFI_STATIC_RX_BUFFER_NUM=16
CONFIG_ESP32_WIFI_DYNAMIC_RX_BUFFER_NUM=64
CONFIG_ESP32_WIFI_DYNAMIC_TX_BUFFER_NUM=64
CONFIG_ESP32_WIFI_AMPDU_TX_ENABLED=y
CONFIG_ESP32_WIFI_TX_BA_WIN=32
CONFIG_ESP32_WIFI_AMPDU_RX_ENABLED=y
CONFIG_ESP32_WIFI_RX_BA_WIN=32

CONFIG_LWIP_IRAM_OPTIMIZATION=y
CONFIG_LWIP_TCP_SND_BUF_DEFAULT=65534
CONFIG_LWIP_TCP_WND_DEFAULT=65534
CONFIG_LWIP_TCP_RECVMBOX_SIZE=64
CONFIG_LWIP_UDP_RECVMBOX_SIZE=64
CONFIG_LWIP_TCPIP_RECVMBOX_SIZE=64

#
#  ESP-NOW debug
#
CONFIG_STORE_HISTORY=y

#
# Log output
#
CONFIG_LOG_DEFAULT_LEVEL_ERROR=y
```
