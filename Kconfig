## Kconfig
```kconfig
menu "ESP-NOW Configuration"
    
    menu "ESP-NOW Security Configuration"

    config ESPNOW_APP_SECURITY
        bool "Secure application data"
        default y
        help
            Compile support for encrypting the application data payload
            (AES128-CCM) with the key distributed by the security handshake.
            This option alone protects no frame: the recommended security
            configuration is listed in the espnow_config_t note in espnow.h.

    config ESPNOW_ALL_SECURITY
        bool "Secure all application data types (recommended)"
        default n
        depends on ESPNOW_APP_SECURITY
        help
            Equivalent to selecting all per-type ESPNOW_*_SECURITY options below.
            It does not make espnow_send() encrypt the frames an application
            sends itself: those are encrypted only when the caller passes a
            frame head with security set (see the espnow_send note). On the
            receive side DATA and RESERVED always count as secured types when
            sec_enable is on; see espnow_set_security_required_for_data_type().
            Plaintext frames of secured types are only rejected with
            ESPNOW_SEC_REJECT_PLAINTEXT. GROUP frames stay plaintext: devices
            must be grouped before a key can be distributed, so group membership
            is not a security boundary.

            Default n keeps every type in plaintext. Enable (recommended)
            together with ESPNOW_SEC_REJECT_PLAINTEXT once every peer holds
            the application key.

    config ESPNOW_CONTROL_SECURITY
        bool "Secure control data (recommended)"
        default n
        depends on ESPNOW_APP_SECURITY && !ESPNOW_ALL_SECURITY
        help
            Enable to secure the control data. Default n keeps control frames
            in plaintext: any device in range can bind to a responder during
            the bind window and control it afterwards. Enable (recommended)
            together with ESPNOW_SEC_REJECT_PLAINTEXT once every peer holds
            the application key.

    config ESPNOW_DEBUG_SECURITY
        bool "Secure debug data (recommended)"
        default n
        depends on ESPNOW_APP_SECURITY && !ESPNOW_ALL_SECURITY
        help
            Enable to secure the debug data (remote console and remote log).
            Default n keeps them in plaintext: any device in range can run
            remote console commands. The remote console is a debug
            facility; if it must stay, enable (recommended) together
            with ESPNOW_SEC_REJECT_PLAINTEXT once every peer holds the
            application key.

    config ESPNOW_OTA_SECURITY
        bool "Secure OTA data (recommended)"
        default n
        depends on ESPNOW_APP_SECURITY && !ESPNOW_ALL_SECURITY
        help
            Enable to secure the OTA data. Default n keeps OTA frames in
            plaintext as in previous releases. This is NOT secure: any device
            in range can push and boot firmware unless Secure Boot is enabled.
            Enable this option (recommended) together with
            ESPNOW_SEC_REJECT_PLAINTEXT as soon as every peer holds the
            application key; the examples keep it off and are lab demos only.

            The library does not verify image authenticity.

            Requires sec_enable in espnow_config_t: with sec_enable off, OTA
            frames are marked secured but never encrypted, so peers drop them
            and OTA does not work.

    config ESPNOW_PROV_SECURITY
        bool "Secure provisioning data (recommended)"
        default n
        depends on ESPNOW_APP_SECURITY && !ESPNOW_ALL_SECURITY
        help
            Enable to secure the provisioning data. Default n keeps
            provisioning frames in plaintext: any device in range can obtain
            the Wi-Fi credentials from a responder whose callback approves it,
            or answer an initiator with forged credentials. Enable
            (recommended) together with ESPNOW_SEC_REJECT_PLAINTEXT once every
            peer holds the application key.

    config ESPNOW_TIME_SECURITY
        bool "Secure time synchronization data (recommended)"
        default n
        depends on ESPNOW_APP_SECURITY && !ESPNOW_ALL_SECURITY
        help
            Enable to secure the time synchronization data. Default n keeps
            time sync frames in plaintext: any device in range can shift the
            responder's clock. Enable (recommended) together with
            ESPNOW_SEC_REJECT_PLAINTEXT once every peer holds the application
            key.

    config ESPNOW_SEC_REJECT_PLAINTEXT
        bool "Reject plaintext frames of secured data types (recommended)"
        default n
        depends on ESPNOW_APP_SECURITY
        help
            When sec_enable is set, drop a received frame whose header marks it
            as plaintext but whose data type is configured as secured
            (CONFIG_ESPNOW_*_SECURITY, plus DATA and RESERVED). The frame is
            dropped before the receive callback and before forwarding, and the
            drop is logged at most once per second per type.

            Default n keeps the previous behaviour: such plaintext frames are
            accepted and handled exactly like authenticated ones. This is NOT
            secure: any device in range can send an unencrypted control,
            provisioning, OTA or data frame and bypass the AEAD check that the
            encrypted path provides. Enable this option (recommended) as soon as
            every peer sends these types encrypted, e.g. after all devices run
            firmware with the same CONFIG_ESPNOW_*_SECURITY settings and hold the
            application key. Per-type exceptions can be made at run time with
            espnow_set_security_required_for_data_type().

    config ESPNOW_SEC_IGNORE_REST
        bool "Ignore unauthenticated SECURITY REST frames (recommended)"
        default n
        depends on ESPNOW_APP_SECURITY
        help
            A SECURITY REST frame asks the responder to clear its security state
            (sec_ver and the initiator it is paired with) so that a new key
            handshake is accepted. The frame is plaintext and its source address
            can be forged, so with this option disabled any device in range can
            force a responder back into the handshake state at will: repeated
            REST frames keep the network re-keying, and the half-open handshake
            window they open can be abused to install a key the network does
            not know. Nothing in this repository sends REST frames.

            Default n keeps the previous behaviour unchanged: REST is honoured
            and only logged at debug level, so a responder gives no visible
            sign of being reset. Enable this option (recommended) unless your own
            initiator relies on sending REST; clear the security state locally
            with espnow_sec_responder_stop() / espnow_erase_key() instead.

    config ESPNOW_SEC_SCAN_MAX_NUM
        int "Maximum responders recorded per security scan"
        range 1 1024
        default 256
        help
            Upper bound on the number of distinct responders stored during a
            single security scan on the initiator.

            ESP-NOW has no source authentication, so without a ceiling a flood
            of INFO frames from spoofed, distinct source MACs would grow the
            initiator's scan list once per frame and could exhaust the heap.
            This cap bounds that transient allocation. The list is grown
            dynamically (one ~12-byte entry per discovered responder), so a
            small deployment pays only for the devices it actually finds; the
            cap merely limits how large a single scan may grow.

            The default of 256 covers large fleets discovered in one scan.
            Raise it only if a single scan must legitimately discover more
            responders than the default (up to 1024, ~12 KB worst case);
            lower it to tighten the anti-flood ceiling on memory-constrained
            targets.

    config ESPNOW_SEC_HANDSHAKE_TIMEOUT_MS
        int "Half-open security handshake timeout on the responder (ms)"
        range 1000 120000
        default 10000
        help
            The responder serves one handshake at a time. After this long
            without completion, a HANDSHAKE from another initiator closes the
            stale session and takes over the slot, so a silent peer cannot hold
            it forever. A normal handshake completes well within one second.

            The frames are unauthenticated, so while the responder runs any
            device in range can hold the slot for this long, repeatedly. Run
            the responder only during commissioning and stop it on
            ESP_EVENT_ESPNOW_SEC_OK, which is posted once the KEY_RESP has been
            sent (see espnow_sec_responder_start / espnow_sec_responder_stop).

    endmenu

    menu "ESP-NOW Light Sleep Configuration"

    config ESPNOW_LIGHT_SLEEP
        bool "Enter light sleep before sending ESP-NOW package"
        default n
        help
            Since sending an ESP-NOW package needs a lot of power, if the coin cell solution is used, it needs some time to charge the electric capacity, so let device enter light sleep to wait some time.

    config ESPNOW_LIGHT_SLEEP_DURATION
        int "Light sleep duration"
        range 15 120
        depends on ESPNOW_LIGHT_SLEEP
        default 30
        help
            Set the duration of light sleep, make it enough to charge the electric capacity.

    endmenu

    menu "ESP-NOW Control Configuration"

    config ESPNOW_CONTROL_AUTO_CHANNEL_SENDING
        bool "Auto control the channel of ESP-NOW package sending"
        default n
        help
            The channel sequence used for ESP-NOW package sending is [1, 6, 11, 1, 6, 11, 2, 3, 4, 5, 7, 8, 9, 10, 12, 13] by default.

            With this option the initiator learns the channel to send on from
            the ACK frames of responders and stores it in NVS (key "ch_key",
            written only when the value changes). ACK is a plaintext frame with
            no authentication, and the initiator keeps accepting it after the
            send completes, so any device in range can set the channel the next
            control frame is sent on, which makes that frame miss the real
            responders until they answer again. Leave this option off where
            that is a concern; the default channel sequence does not depend on
            received frames.

    config ESPNOW_CONTROL_WAIT_ACK_DURATION
        int "Duration to wait for ACK"
        range 3 100
        depends on ESPNOW_CONTROL_AUTO_CHANNEL_SENDING
        default 40
        help
            Set the duration to wait for ACK. Use a value big enough to avoid retransmissions.

    config ESPNOW_CONTROL_RETRANSMISSION_TIMES
        int "Retransmission times when sending an ESP-NOW package from the saved channel"
        range 1 15
        depends on ESPNOW_CONTROL_AUTO_CHANNEL_SENDING
        default 5
        help
            The ESP-NOW package will be sent on the saved channel for this retransmission times, then try the auto channel sending.

    config ESPNOW_CONTROL_AUTO_CHANNEL_FORWARD
        bool "Auto control ESP-NOW package forwarding on different channels"
        depends on ESPNOW_CONTROL_AUTO_CHANNEL_SENDING
        default n
        help
            The ESP-NOW package will be forwarded on different channels.

    config ESPNOW_CONTROL_FORWARD_TTL
        int "The max number of hops when forward data"
        range 1 31
        depends on ESPNOW_CONTROL_AUTO_CHANNEL_SENDING
        default 10
        help
            The ESP-NOW package will be forward when the number of hops in data transfer is not zero.

    config ESPNOW_CONTROL_FORWARD_RSSI
        int "The worst signal of the hop when forward data"
        range -70 -30
        depends on ESPNOW_CONTROL_AUTO_CHANNEL_SENDING
        default -55
        help
            The ESP-NOW package will not be forward when the data packet signal received by the receiving device is lower than the value.

    endmenu

    menu "ESP-NOW OTA configuration"

    config ESPNOW_OTA_FIRMWARE_SIZE_MAX
        int "Maximum OTA firmware size (bytes)"
        range 65536 13631280
        default 4194304
        help
            Largest firmware image (in bytes) the OTA responder will accept.
            Set this to your OTA (app) partition size.

            The responder sizes its packet-progress bitmap from this value, so a
            larger setting supports bigger firmware at the cost of a little more
            RAM during an upgrade, and a smaller setting saves RAM. Firmware
            larger than this (or a malformed frame claiming more packets) is
            rejected, which is what prevents the progress-bitmap heap overflow.

            The upper bound (~13 MB) is limited by the 16-bit packet_num field in
            the OTA wire protocol.

    config ESPNOW_OTA_RETRANSMISSION_TIMES
        int "Retransmission times when sending an ESP-NOW OTA package from the saved channel"
        range 1 15
        default 2
        help
            The ESP-NOW package will be sent on the saved channel for this retransmission times

    config ESPNOW_OTA_RETRY_COUNT
        int "OTA send retry count"
        default 50
        help
            Number of times initiator will try to update device
    
    config ESPNOW_OTA_SEND_FORWARD_TTL
        int "The max number of hops when forward data"
        range 0 31
        default 0
        help
            The ESP-NOW OTA package will be forward when the number of hops in data transfer is not zero.
    
    config ESPNOW_OTA_SEND_FORWARD_RSSI
        int "The worst signal of the hop when forward data"
        range -70 -30
        default -65
        help
            The ESP-NOW OTA package will not be forward when the data packet signal received by the receiving device is lower than the value.

    config ESPNOW_OTA_WAIT_RESPONSE_TIMEOUT
        int "Time to wait for responder to answer in ms"
        default 10000
        range 100 10000
        help
            The ESP-NOW OTA will wait for respond for maximum given time

    config ESPNOW_OTA_RESTART_MIN_INTERVAL_MS
        int "Minimum interval between peer-triggered OTA restarts (ms, 0 disables)"
        default 1000
        range 0 60000
        help
            Minimum spacing between OTA session (re)starts triggered by an incoming
            STATUS frame on the responder. Each restart runs esp_ota_begin, which
            erases the whole update partition, so without a floor an unauthenticated
            STATUS flood can wear out flash and deny service.

            A legitimate upgrade begins once per firmware, so this floor does not
            affect normal upgrades. It only rejects restarts that arrive closer
            together than this interval; a manual retry after a failed upgrade should
            use an interval at least this long, or set 0 to disable the limit.
    endmenu

    config ESPNOW_GROUP_COUNT_MAX
        int "Maximum number of groups this device may join"
        range 8 65535
        default 32
        help
            Unauthenticated GROUP frames can add groups remotely, so an unbounded
            list could exhaust the heap. When the cap is reached the oldest
            application group is evicted. The built-in OTA/PROV/SEC groups do not
            count and are never evicted.

    config ESPNOW_AUTO_RESTORE_CHANNEL
        bool "Restore primary channel at the end of ESP-NOW package sending"
        default n
        help
            If the primary channel has changed during package sending, restore the primary channel at the end of sending.

    config ESPNOW_DATA_FAST_ACK
        bool "Call the ack handler immediately in the data receive callback"
        default n
        help
            Select whether to call the ack handler immediately in the data receive callback, or queue it and call it when idle.

    menu "ESP-NOW Task Configuration"

        comment "Avoid heavy processing in handlers; offload to app task via queues."

    config ESPNOW_TASK_STACK_SIZE
        int "Stack size of espnow task"
        range 2048 8192
        default 4096
        help
            Set the stack size of the espnow task.
            Increase this value if you perform complex operations in message handlers
            (e.g., JSON parsing, encryption, deep function calls) and encounter stack overflow.

    config ESPNOW_TASK_PRIORITY
        int "Priority of espnow task"
        range 1 25
        default 1
        help
            Set the priority of the espnow main task.
            Higher values indicate higher priority. The default is tskIDLE_PRIORITY + 1 (i.e., 1).
            Increase this value if you need faster message processing or have real-time requirements.

    endmenu

    menu "ESP-NOW Utils Configuration"
    choice ESPNOW_MEM_ALLOCATION_LOCATION
        prompt "The memory location allocated by MALLOC, CALLOC and REALLOC"
        help 
            choice where to allocate memory, can be SPIRAM or default

        config ESPNOW_MEM_ALLOCATION_DEFAULT
            bool "default allocation strategy"
        config ESPNOW_MEM_ALLOCATION_SPIRAM
            depends on ESP32S3_SPIRAM_SUPPORT || ESP32S2_SPIRAM_SUPPORT || ESP32_SPIRAM_SUPPORT
            bool "allocate memory in SPIRAM"
    endchoice
        
    config ESPNOW_MEM_DEBUG
        bool "Memory debug"
        default y
        help
            Memory debug.

    config ESPNOW_MEM_DBG_INFO_MAX
        int "The max records for Memory debug."
        default 128
        help
            Config Memory debug record max.

    config ESPNOW_NVS_NAMESPACE
        string "Namespace where data is stored in NVS"
        default "espnow"
        help
            Namespace where data is stored in NVS.

    config ESPNOW_REBOOT_UNBROKEN_INTERVAL_TIMEOUT
        int "Continuous reboot interval(ms)"
        default 5000
        help
        A reset within this many milliseconds after boot counts as a continuous
        reboot for ESPNOW_REBOOT_UNBROKEN_FALLBACK_COUNT; staying up longer
        clears the counter. Deep sleep and brown-out resets do not count.

    config ESPNOW_REBOOT_UNBROKEN_FALLBACK_COUNT
        int "Continuous restart triggers version rollback"
        default 30
        help
        After this many continuous reboots the running app is marked invalid
        and the firmware in the other OTA slot is booted. Enable
        CONFIG_BOOTLOADER_APP_ANTI_ROLLBACK so repeated externally triggered
        crashes cannot downgrade the device to an older image. 0 disables
        the rollback.
    endmenu

    menu "ESP-NOW Debug Configuration" 
    menu "Debug console Configuration"
        config ESPNOW_STORE_HISTORY
            bool "Store command history in flash"
            default y
            help
                Linenoise line editing library provides functions to save and load
                command history. If this option is enabled, initializes a FAT filesystem
                and uses it to store command history.
    endmenu

    menu "Debug Log Configuration"
        config ESPNOW_DEBUG_LOG_PARTITION_LABEL_DATA
            string "The partition label used to store log info"
            default "log_info"
            help
                Store log info partition label.
            
        config ESPNOW_DEBUG_LOG_PARTITION_LABEL_NVS
            string "The partition label used to store log status"
            default "log_status"
            help
                Store log status partition label.

        config ESPNOW_DEBUG_LOG_FILE_MAX_SIZE
            int "The file size of the log"
            range 8196 131072
            default 65536
            help
                The file size of the log

        config ESPNOW_DEBUG_LOG_PARTITION_OFFSET
            int "Offset of the log information in partition"
            range 0 524288
            default 0
            help
                Offset of the log information partition

        config ESPNOW_DEBUG_LOG_PRINTF_ENABLE
            bool "Output the `printf` information of the espnow module"
            default n
            help
                Output the `printf` information of the espnow module
    endmenu

    choice ESPNOW_DEBUG_CONSOLE_UART_NUM
        prompt "UART for console input"
        default ESPNOW_DEBUG_CONSOLE_UART_NUM_0
        help
            UART to be selected for serial console.

        config ESPNOW_DEBUG_CONSOLE_UART_NUM_0
            bool "UART0"
        config ESPNOW_DEBUG_CONSOLE_UART_NUM_1
            bool "UART1"
    endchoice

    config ESPNOW_DEBUG_CONSOLE_UART_NUM
        int
        default 0 if ESPNOW_DEBUG_CONSOLE_UART_NUM_0
        default 1 if ESPNOW_DEBUG_CONSOLE_UART_NUM_1
    endmenu

endmenu
```
