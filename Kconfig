## examples/coin_cell_demo/switch/main/Kconfig
```kconfig
menu "Example Configuration"

    orsource "$IDF_PATH/examples/common_components/env_caps/$IDF_TARGET/Kconfig.env_caps"

    config EXAMPLE_USE_COIN_CELL_BUTTON
        bool "Use coin cell button"
        default y
        help
            By default, this demo uses the coin cell button to control the bulb, but if you don't have such button, you can use other ESP32 series DevKit to simulate, if so, please set this option to N.

    config EXAMPLE_SWITCH_STATUS_PERSISTED
        bool "Persist switch status in nvs"
        default n
        help
            If switch status is persisted in nvs, status value is stored in nvs and represents ON or OFF. If it is not persisted, status value represents TOGGLE.

    choice EXAMPLE_MAX_CPU_FREQ
        prompt "Maximum CPU frequency"
        default EXAMPLE_MAX_CPU_FREQ_160 if !IDF_TARGET_ESP32H2 && !IDF_TARGET_ESP32C2
        default EXAMPLE_MAX_CPU_FREQ_96 if IDF_TARGET_ESP32H2
        default EXAMPLE_MAX_CPU_FREQ_120 if IDF_TARGET_ESP32C2
        depends on PM_ENABLE
        help
            Maximum CPU frequency to use for dynamic frequency scaling.

        config EXAMPLE_MAX_CPU_FREQ_80
            bool "80 MHz"
        config EXAMPLE_MAX_CPU_FREQ_96
            bool "96 MHz"
            depends on IDF_TARGET_ESP32H2
        config EXAMPLE_MAX_CPU_FREQ_160
            bool "160 MHz"
        config EXAMPLE_MAX_CPU_FREQ_120
            bool "120 MHz"
            depends on IDF_TARGET_ESP32C2
        config EXAMPLE_MAX_CPU_FREQ_240
            bool "240 MHz"
            depends on IDF_TARGET_ESP32 || IDF_TARGET_ESP32S3
    endchoice

    config EXAMPLE_MAX_CPU_FREQ_MHZ
        int
        default 80 if EXAMPLE_MAX_CPU_FREQ_80
        default 96 if EXAMPLE_MAX_CPU_FREQ_96
        default 120 if EXAMPLE_MAX_CPU_FREQ_120
        default 160 if EXAMPLE_MAX_CPU_FREQ_160
        default 240 if EXAMPLE_MAX_CPU_FREQ_240

    choice EXAMPLE_MIN_CPU_FREQ
        prompt "Minimum CPU frequency"
        default EXAMPLE_MIN_CPU_FREQ_40M if !IDF_TARGET_ESP32H2 && !IDF_TARGET_ESP32C2
        default EXAMPLE_MIN_CPU_FREQ_32M if IDF_TARGET_ESP32H2
        default EXAMPLE_MIN_CPU_FREQ_26M if IDF_TARGET_ESP32C2
        depends on PM_ENABLE
        help
            Minimum CPU frequency to use for dynamic frequency scaling.
            Should be set to XTAL frequency or XTAL frequency divided by integer.

        config EXAMPLE_MIN_CPU_FREQ_80M
            bool "80 MHz"
            depends on !(IDF_TARGET_ESP32 && EXAMPLE_MAX_CPU_FREQ_240)
            help
                ESP32 does not support switching between 240M and 80M.The root cause
                is that when switching between 240M and 80M, we need to disable
                BBPLL and then re-enable it with a different frequency.Since the
                Bluetooth baseband works from PLL frequency, it will temporarily
                lose its 80 MHz clock, while the BBPLL is disabled.
        config EXAMPLE_MIN_CPU_FREQ_40M
            bool "40 MHz (use with 40MHz XTAL)"
            depends on XTAL_FREQ_40 || XTAL_FREQ_AUTO
        config EXAMPLE_MIN_CPU_FREQ_32M
            bool "32 MHz (use with 32MHz XTAL)"
            depends on IDF_TARGET_ESP32H2
            depends on XTAL_FREQ_32 || XTAL_FREQ_AUTO
        config EXAMPLE_MIN_CPU_FREQ_26M
            bool "26 MHz (use with 26MHz XTAL)"
            depends on IDF_TARGET_ESP32C2
            depends on XTAL_FREQ_26 || XTAL_FREQ_AUTO
        config EXAMPLE_MIN_CPU_FREQ_20M
            bool "20 MHz (use with 40MHz XTAL)"
            depends on XTAL_FREQ_40 || XTAL_FREQ_AUTO
        config EXAMPLE_MIN_CPU_FREQ_10M
            bool "10 MHz (use with 40MHz XTAL)"
            depends on XTAL_FREQ_40 || XTAL_FREQ_AUTO
    endchoice

    config EXAMPLE_MIN_CPU_FREQ_MHZ
        int
        default 80 if EXAMPLE_MIN_CPU_FREQ_80M
        default 40 if EXAMPLE_MIN_CPU_FREQ_40M
        default 32 if EXAMPLE_MIN_CPU_FREQ_32M
        default 26 if EXAMPLE_MIN_CPU_FREQ_26M
        default 20 if EXAMPLE_MIN_CPU_FREQ_20M
        default 10 if EXAMPLE_MIN_CPU_FREQ_10M

endmenu
```

## examples/debug/main/Kconfig.projbuild
```kconfig
menu "ESP-NOW Debug Example Configuration"

    config FLASH_LOG_POST_URL
        string "Flash log url endpoint"
        default "http://192.168.0.3:8070/flash_log"
        help
            Flash log url endpoint.

endmenu
```

## examples/debug/sdkconfig.defaults
```kconfig
# Override some defaults in application project.

#
# Serial flasher config
#
CONFIG_ESPTOOLPY_FLASHSIZE_4MB=y
CONFIG_ESPTOOLPY_FLASHMODE_QIO=y
CONFIG_ESPTOOLPY_FLASHFREQ_80M=y
CONFIG_ESPTOOLPY_BAUD_921600B=y

#
# Partition Table
#
CONFIG_PARTITION_TABLE_CUSTOM=y
CONFIG_PARTITION_TABLE_CUSTOM_FILENAME="partitions.csv"
```

## examples/dev_kits/light_pwm/main/Kconfig.projbuild
```kconfig
menu "Example Configuration"
    menu "Light development board selection "
        choice LIGHT_TYPE
            prompt "light hardware type"
            default LIGHT_TYPE_CUSTOM
            help
                Choose different types of lamp development boards.
    
            config LIGHT_TYPE_MOONLIGHT
                bool "ESP32 moonlight"
            config LIGHT_TYPE_MESHKIT
                bool "ESP32-MeshKit Light"
            config LIGHT_TYPE_CUSTOM
                bool "Custom"
        endchoice

        config LIGHT_GPIO_RED
            int "Light red pin GPIO number"
            depends on LIGHT_TYPE_CUSTOM
            range 0 46
            default 25 if IDF_TARGET_ESP32
            default 10 if IDF_TARGET_ESP32S2
            default 1  if IDF_TARGET_ESP32C3
            help
                There are more enumerations like that
                up to GPIO39, excluding GPIO20, GPIO24 and GPIO28..31.
                They are not shown here to reduce redundant information.
                @note GPIO34..39 are input mode only.
        
        config LIGHT_GPIO_GREEN
            int "Light green pin GPIO number"
            depends on LIGHT_TYPE_CUSTOM
            range 0 46
            default 26 if IDF_TARGET_ESP32
            default 6 if IDF_TARGET_ESP32S2
            default 2 if IDF_TARGET_ESP32C3
            help
                There are more enumerations like that
                up to GPIO39, excluding GPIO20, GPIO24 and GPIO28..31.
                They are not shown here to reduce redundant information.
                @note GPIO34..39 are input mode only.
        
        config LIGHT_GPIO_BLUE
            int "Light blue pin GPIO number"
            depends on LIGHT_TYPE_CUSTOM
            range 0 46
            default 27 if IDF_TARGET_ESP32
            default 7 if IDF_TARGET_ESP32S2
            default 3 if IDF_TARGET_ESP32C3
            help
                There are more enumerations like that
                up to GPIO39, excluding GPIO20, GPIO24 and GPIO28..31.
                They are not shown here to reduce redundant information.
                @note GPIO34..39 are input mode only.
        
        config LIGHT_GPIO_COLD
            int "Light cold color pin GPIO number"
            depends on LIGHT_TYPE_CUSTOM
            range 0 46
            default 5
            help
                There are more enumerations like that
                up to GPIO39, excluding GPIO20, GPIO24 and GPIO28..31.
                They are not shown here to reduce redundant information.
                @note GPIO34..39 are input mode only.
        
        config LIGHT_GPIO_WARM
            int "Light warm color pin GPIO number"
            depends on LIGHT_TYPE_CUSTOM
            range 0 46
            default 4
            help
                There are more enumerations like that
                up to GPIO39, excluding GPIO20, GPIO24 and GPIO28..31.
                They are not shown here to reduce redundant information.
                @note GPIO34..39 are input mode only.
        
        config LIGHT_FADE_PERIOD_MS
            int "The time from the current color to the next color"
            default 200
            help
                The time from the current color to the next color.
        
        config LIGHT_BLINK_PERIOD_MS
            int "Period of blinking lights"
            default 3000
            help
                Period of blinking lights.
    endmenu
endmenu
```

## examples/dev_kits/sensor_human_infrared/sdkconfig.defaults
```kconfig
# Override some defaults in application project.


#
# Bootloader config
#
CONFIG_BOOTLOADER_COMPILER_OPTIMIZATION_PERF=y
CONFIG_BOOTLOADER_LOG_LEVEL_WARN=y
CONFIG_BOOTLOADER_LOG_LEVEL=2
CONFIG_BOOTLOADER_SKIP_VALIDATE_IN_DEEP_SLEEP=y
CONFIG_BOOTLOADER_SKIP_VALIDATE_ON_POWER_ON=y
CONFIG_BOOTLOADER_SKIP_VALIDATE_ALWAYS=y


#
# Log output
#
CONFIG_LOG_DEFAULT_LEVEL_WARN=y
CONFIG_LOG_DEFAULT_LEVEL=2
CONFIG_LOG_COLORS=y

#
# FreeRTOS
#
CONFIG_FREERTOS_HZ=1000
CONFIG_FREERTOS_TIMER_TASK_STACK_DEPTH=3072

CONFIG_ESP_TIMER_TASK_STACK_SIZE=4096
CONFIG_ESP_TASK_WDT_PANIC=y
CONFIG_ESP_TASK_WDT_TIMEOUT_S=10
```

## examples/get-started/main/Kconfig.projbuild
```kconfig
menu "Example Configuration"
    config RETRY_NUM
        int "Packet retransmission count"
        default 5
        help
            Set the packet retransmission count. The more retransmission 
            times, the lower the throughput rate.

endmenu
```

## examples/ota/main/Kconfig.projbuild
```kconfig
menu "Example Configuration"
    config APP_ESPNOW_FIRMWARE_UPGRADE_URL
        string "Firmware upgrade URL"
        default "http://192.168.0.3:8070/hello_world.bin"
        depends on APP_ESPNOW_OTA_INITIATOR
        help
            URL of server which hosts the firmware image.

    choice APP_ESPNOW_OTA_MODE
        bool "ESP-NOW Mode"
        default APP_ESPNOW_OTA_INITIATOR
        help
            Select the ESP-NOW Mode.

        config APP_ESPNOW_OTA_INITIATOR
            bool "Initiator Mode"
            help
                Select the ESP-NOW OTA initiator Mode.

        config APP_ESPNOW_OTA_RESPONDER
            bool "Responder Mode"
            help
                Select the ESP-NOW OTA responder Mode.

    endchoice

    config APP_ESPNOW_OTA_MODE
        int
        default 0 if APP_ESPNOW_OTA_INITIATOR
        default 1 if APP_ESPNOW_OTA_RESPONDER

endmenu
```

## examples/provisioning/main/Kconfig.projbuild
```kconfig
menu "Example Configuration"
    choice APP_ESPNOW_PROV_MODE
        bool "ESP-NOW provisioning Mode"
        default APP_ESPNOW_PROV_INITIATOR
        help
            Select the ESP-NOW provisioning Mode.

        config APP_ESPNOW_PROV_INITIATOR
            bool "Initiator Mode"
            help
                Select the ESP-NOW provisioning initiator Mode.

        config APP_ESPNOW_PROV_RESPONDER
            bool "Responder Mode"
            help
                Select the ESP-NOW provisioning responder Mode.

    endchoice

    config APP_ESPNOW_PROV_MODE
        int
        default 0 if APP_ESPNOW_PROV_INITIATOR
        default 1 if APP_ESPNOW_PROV_RESPONDER

        config APP_ESPNOW_WIFI_SSID
            string "WiFi SSID"
            depends on APP_ESPNOW_PROV_RESPONDER
            default "myssid"
            help
                SSID (network name) for the example to connect to.

        config APP_ESPNOW_WIFI_PASSWORD
            string "WiFi Password"
            depends on APP_ESPNOW_PROV_RESPONDER
            default "mypassword"
            help
                WiFi password (WPA or WPA2 or WPA3) for the example to use.

endmenu
```

## examples/provisioning/sdkconfig.defaults
```kconfig
# Enable protocomm security version 1 for ESP-NOW security
CONFIG_ESP_PROTOCOMM_SUPPORT_SECURITY_VERSION_1=y
```

## examples/security/main/Kconfig.projbuild
```kconfig
menu "Example Configuration"
    config APP_ESPNOW_RETRY_NUM
        int "Packet retransmission count"
        default 5
        help
            Set the packet retransmission count. The more retransmission 
            times, the lower the throughput rate.

    config APP_ESPNOW_SESSION_POP
        string "Proof of Possession"
        default "espnow_pop"
        help
            Proof of Possession (PoP) string used to authorize session and derive shared key.

    config APP_ESPNOW_SEC_OPTION
        bool "The payload data is ciphertext or plaintext when enable security"
        default y
        help
            Send ciphertext or plaintext when enable security.
    
    config APP_ESNOW_STRESS_OPTION
        bool "Select stress or function when enable security"
        default n
        help
            Select stress or function when enable security.

    choice APP_ESPNOW_SEC_MODE
        bool "ESP-NOW Mode"
        default APP_ESPNOW_SEC_INITIATOR
        help
            Select the ESP-NOW Mode.

        config APP_ESPNOW_SEC_INITIATOR
            bool "Initiator Mode"
            help
                Select the ESP-NOW SEC initiator Mode.

        config APP_ESPNOW_SEC_RESPONDER
            bool "Responder Mode"
            help
                Select the ESP-NOW SEC responder Mode.

    endchoice

    config APP_ESPNOW_SEC_MODE
        int
        default 0 if APP_ESPNOW_SEC_INITIATOR
        default 1 if APP_ESPNOW_SEC_RESPONDER

endmenu
```

## examples/security/sdkconfig.defaults
```kconfig
# Override some defaults in application project.

#
# Serial flasher config
#
CONFIG_ESPTOOLPY_FLASHSIZE_4MB=y
CONFIG_ESPTOOLPY_FLASHMODE_QIO=y
CONFIG_ESPTOOLPY_FLASHFREQ_80M=y
CONFIG_ESPTOOLPY_BAUD_921600B=y

#
# FreeRTOS
#
CONFIG_FREERTOS_HZ=1000
CONFIG_FREERTOS_UNICORE=y
CONFIG_FREERTOS_USE_TRACE_FACILITY=y
CONFIG_FREERTOS_USE_STATS_FORMATTING_FUNCTIONS=y
CONFIG_FREERTOS_VTASKLIST_INCLUDE_COREID=y
CONFIG_FREERTOS_GENERATE_RUN_TIME_STATS=y
CONFIG_FREERTOS_TIMER_TASK_STACK_DEPTH=3072

CONFIG_ESP_TIMER_TASK_STACK_SIZE=4096
CONFIG_ESP_TASK_WDT_PANIC=y
CONFIG_ESP_TASK_WDT_TIMEOUT_S=10
```
